## main/Kconfig.projbuild
```kconfig
menu "Stadia dongle"

    menu "Dongle status RGB LED"

        config DONGLE_LED_ENABLED
            bool "Enable status RGB LED"
            default y
            help
                Enable the low-priority status LED task. Disable this for boards
                without an RGB LED.

        choice DONGLE_LED_TYPE
            prompt "Status LED type"
            depends on DONGLE_LED_ENABLED
            default DONGLE_LED_TYPE_ADDRESSABLE

            config DONGLE_LED_TYPE_ADDRESSABLE
                bool "Single addressable RGB LED (WS2812/SK6812-style)"

            config DONGLE_LED_TYPE_NOOP
                bool "No-op"
        endchoice

        config DONGLE_LED_GPIO
            int "Addressable RGB LED GPIO"
            depends on DONGLE_LED_ENABLED && DONGLE_LED_TYPE_ADDRESSABLE
            default 35
            range 0 48
            help
                GPIO used by the board's addressable RGB LED. M5Stack AtomS3U
                uses GPIO 35.

        config DONGLE_LED_BRIGHTNESS
            int "Status LED brightness"
            depends on DONGLE_LED_ENABLED
            default 96
            range 1 255
            help
                Peak drive after the perceptual curve. 96 keeps the AtomS3U
                RGB channels saturated enough that orange, white, cyan and
                magenta stay distinct. Lower it if the LED is too bright.

    endmenu

    menu "Dongle board button"

        config DONGLE_BUTTON_ENABLED
            bool "Enable onboard physical button"
            default y
            help
                Poll the board's user button (active-low with internal pull-up).
                Short press starts the Wi-Fi Web UI and can send USB remote wake.

        config DONGLE_BUTTON_GPIO
            int "Onboard button GPIO"
            depends on DONGLE_BUTTON_ENABLED
            default 41
            range 0 48
            help
                GPIO for the active-low user button. M5Stack AtomS3U uses GPIO 41.

    endmenu

    config DONGLE_IR_TX_HOLD_LOW
        bool "Hold IR transmitter GPIO low"
        default y
        help
            Drive the onboard IR LED data pin low so it never transmits.
            M5Stack AtomS3U IR TX is GPIO 12.

    config DONGLE_IR_TX_GPIO
        int "IR transmitter GPIO"
        depends on DONGLE_IR_TX_HOLD_LOW
        default 12
        range 0 48
        help
            GPIO connected to the IR emitter. Held as output low at boot.

    config DONGLE_USB_STAGGERED_PAD_START
        bool "Stagger Xbox pad start until the previous pad is assigned"
        default n
        help
            Hold the first input report of pad N until Windows has sent an
            LED-ring (player slot) command for pad N-1, or 400 ms have passed.
            This is an experiment for the Windows XInput ordering race. Leave
            it off until a hardware pass shows it produces a stable order.
            Linux does not send those LED commands, so enabling it delays pads
            2 and 3 by up to 400 ms after each plug-in.

endmenu
```
